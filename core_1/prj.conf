## prj.conf
```kconfig
CONFIG_SEMIHOST=y
CONFIG_LOG=y
CONFIG_LOG_BACKEND_UART=n
CONFIG_LOG_BACKEND_SEMIHOST=y

CONFIG_FLASH_SIZE=1024

# For Core 1
CONFIG_FLASH_BASE_ADDRESS=0x10100000

CONFIG_MBOX=y
CONFIG_MBOX_RPI_PICO=y
CONFIG_IPM=y
CONFIG_IPM_MBOX=y
```

## boards/rpi_pico.overlay
```dts
&sram0 {
	reg = <0x20020000 DT_SIZE_K(128)>;
};

&code_partition {
	reg = <0x10100000 DT_SIZE_M(1)>;
};

&mbox1 {
	status = "okay";
};

&ipm_mbox1 {
	status = "okay";
};
```

## src/main.c
```c
/*
 * Copyright (c) 2019 Nordic Semiconductor ASA
 * Copyright (c) 2026 Eric Hay
 *
 * SPDX-License-Identifier: Apache-2.0
 */

#include <zephyr/kernel.h>
#include <zephyr/drivers/ipm.h>

static int i = 0;

static const struct device *ipm_dev;

static void ipm_callback(const struct device *dev, void *context, uint32_t id, volatile void *data)
{
	int received_value = *(int *)data;
	printk("Received IPM message with value: %d\n", received_value);
}

int main(void)
{
	int status;

	printk("Hello World from Core 1!\n");

	ipm_dev = DEVICE_DT_GET(DT_NODELABEL(ipm_mbox1));
	if (!ipm_dev) {
		printk("Failed to get IPM device\n");
		return -1;
	}

	ipm_register_callback(ipm_dev, ipm_callback, NULL);

	status = ipm_set_enabled(ipm_dev, 1);
	if (status != 0) {
		printk("Failed to enable IPM device\n");
		return -1;
	}

	while (1) {
		k_msleep(10000);
		printk("Running main loop iteration %d\n", i++);
	}

	return 0;
}
```
